# processor: IP-XACT component
VLNV spiritconsortium.org:Leon2TLM:processor:1.4

## Parameters
code_file = master.tbl

## Bus interfaces (logical=physical port)
AHB_Master: initiator amba.com:AMBA2:AHB:r2p0_6, address space main_AS
  PV_TRANS=ahb_master_port
APB_Slave: target amba.com:AMBA2:APB:r2p0_4, memory map APB_MM
  PV_TRANS=apb_slave_port
INT_Slave: target spiritconsortium.org:busdef.leon2:IntProc:v1.0
  IRL=irl_port, IRQVEC=irqvec_port, INTack=intack_port

## Ports
transactional ahb_master_port
transactional apb_slave_port
in irl_port
out irqvec_port
out intack_port
in clk
in rst_an

## Address spaces and blocks
main_AS: range 4 * (2 ** 30), width 32
APB_MM.registers: base , range 4, width 32, register
APB_MM.lowest1k: base , range 1020, width 32, memory
APB_MM.midlow1k: base , range 1 * (2 ** 10), width 32, memory
APB_MM.midhigh1k: base , range 1 * (2 ** 10), width 32, memory
APB_MM.highest1kx7_0: base , range 1 * (2 ** 10), width 8, memory
APB_MM.highest1kx15_8: base , range 1 * (2 ** 10), width 8, memory
APB_MM.highest1kx23_16: base , range 1 * (2 ** 10), width 8, memory
APB_MM.highest1kx31_24: base , range 1 * (2 ** 10), width 8, memory

## Registers
Registers are 32-bit, read-only, no defined reset value unless marked. A register's access mark holds for its fields unless they carry their own. Offsets are from the block's base; lines under a group give offsets from that group; [hi:lo] are bit positions; {n}, {i} and the like mark numbered series; 'fields as' and 'values as' point back to an identical list; <NAME> marks a mode.

## APB_MM.registers
Base 0x00000000
0x00 Failures
  [31:0] NumFailures — Number of failures from the AHB BFM

## Notices in the file
Copyright (c) 2005, 2006, 2007, 2008, 2009 The SPIRIT Consortium.
This work forms part of a deliverable of The SPIRIT Consortium.
Use of these materials are governed by the legal terms and conditions
outlined in the disclaimer available from www.spiritconsortium.org.
This source file is provided on an AS IS basis.  The SPIRIT
Consortium disclaims any warranty express or implied including
any warranty of merchantability and fitness for use for a
particular purpose.
The user of the source file shall indemnify and hold The SPIRIT
Consortium and its members harmless from any damages or liability.
