# uart_tac: IP-XACT component
VLNV spiritconsortium.org:Leon2TLM:uart_tac:1.0

## Parameters
module_name = ""
resetOnInitialize = true
debug_level = 0
endianness = TLM_BIG_ENDIAN

## Bus interfaces (logical=physical port)
ambaAPB: target amba.com:AMBA2:APB:r2p0_4, memory map ambaAPB
  tac_if=ambaAPB

## Ports
transactional ambaAPB

## Address spaces and blocks
ambaAPB.ambaAPB: base 0, range 24, width 32, register

## Registers
Registers are 32-bit, read-write, reset 0x0 unless marked. A register's access mark holds for its fields unless they carry their own. Offsets are from the block's base; lines under a group give offsets from that group; [hi:lo] are bit positions; {n}, {i} and the like mark numbered series; 'fields as' and 'values as' point back to an identical list; <NAME> marks a mode.

## ambaAPB.ambaAPB
Base 0x00000000
0x00 data — Data read/write register
0x04 status ro reset 0x6
0x08 control
0x0C scalarReload

## Notices in the file
Copyright (c) 2005, 2006, 2007, 2008, 2009 The SPIRIT Consortium.
This work forms part of a deliverable of The SPIRIT Consortium.
Use of these materials are governed by the legal terms and conditions
outlined in the disclaimer available from www.spiritconsortium.org.
This source file is provided on an AS IS basis.  The SPIRIT
Consortium disclaims any warranty express or implied including
any warranty of merchantability and fitness for use for a
particular purpose.
The user of the source file shall indemnify and hold The SPIRIT
Consortium and its members harmless from any damages or liability.
