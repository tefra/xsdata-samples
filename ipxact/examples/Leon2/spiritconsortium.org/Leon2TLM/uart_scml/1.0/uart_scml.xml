# uart_scml: IP-XACT component
VLNV spiritconsortium.org:Leon2TLM:uart_scml:1.0

## Bus interfaces (logical=physical port)
ambaAPB: target amba.com:AMBA2:APB:r2p0_4, memory map uartScmlMemoryMap
  PV=pPVTargetPort
Interrupt: initiator spiritconsortium.org:busdef.interrupt:interrupt:1.0
  IRQ=pInterrupt
SerialOut: initiator spiritconsortium.org:busdef.generic:serial:1.0
  RW_TRANSACTION=pSerialOut
SerialIn: target spiritconsortium.org:busdef.generic:serial:1.0
  RW_TRANSACTION=pSerialIn

## Ports
transactional pPVTargetPort
transactional pSerialOut
transactional pSerialIn
in pReset
out pInterrupt

## Address spaces and blocks
uartScmlMemoryMap.UART_REG: base uartScmlBaseAddress, range 24, width 32, register

## Registers
Registers are 32-bit, read-write, reset 0x0 unless marked. A register's access mark holds for its fields unless they carry their own. Offsets are from the block's base; lines under a group give offsets from that group; [hi:lo] are bit positions; {n}, {i} and the like mark numbered series; 'fields as' and 'values as' point back to an identical list; <NAME> marks a mode.

## uartScmlMemoryMap.UART_REG — Receiver Buffer Register
Base 0xB0000000
0x00 UART_REG_RBR ro
0x00 UART_REG_THR wo — Transmitter Holding Register
0x04 UART_REG_IER — Interrupt Enable (Mask) Register
0x08 UART_REG_IIR ro reset 0x1 — Interrupt Identification Register
0x08 UART_REG_FCR wo reset 0x1 — FIFO Control Register
0x0C UART_REG_LCR reset 0xB — Line Control Register
0x14 UART_REG_LSR reset 0x20 — Line Status Register

## Notices in the file
Copyright (c) 2005, 2006, 2007, 2008, 2009 The SPIRIT Consortium.
This work forms part of a deliverable of The SPIRIT Consortium.
Use of these materials are governed by the legal terms and conditions
outlined in the disclaimer available from www.spiritconsortium.org.
This source file is provided on an AS IS basis.  The SPIRIT
Consortium disclaims any warranty express or implied including
any warranty of merchantability and fitness for use for a
particular purpose.
The user of the source file shall indemnify and hold The SPIRIT
Consortium and its members harmless from any damages or liability.
