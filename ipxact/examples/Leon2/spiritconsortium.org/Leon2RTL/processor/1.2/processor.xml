# processor: IP-XACT component
VLNV spiritconsortium.org:Leon2RTL:processor:1.2

## Parameters
local_memory_start_addr = (start_addr_local ) / 65536
local_memory_addr_bits = $floor($ln(range_local + 1)/$ln(2) )
code_file = master.tbl

## Bus interfaces (logical=physical port)
AHBClk: target spiritconsortium.org:busdef.clock:clock:1.0
  CLK=hclk
AHBReset: target spiritconsortium.org:busdef.reset:reset:1.0
  RESETn=hresetn
AHBmaster: initiator amba.com:AMBA2:AHB:r2p0_6, address space main
  HRDATA=hrdata, HGRANTx=hgrant, HADDR=haddr, HTRANS=htrans, HWRITE=hwrite, HSIZE=hsize, HBURST=hburst, HPROT=hprot, HWDATA=hwdata, HBUSREQx=hbusreq, HREADY=hready, HRESP=hresp, HCLK=hclk, HRESETn=hresetn
APBClk: target spiritconsortium.org:busdef.clock:clock:1.0
  CLK=pclk
APBReset: target spiritconsortium.org:busdef.reset:reset:1.0
  RESETn=presetn
APBslave: target amba.com:AMBA2:APB:r2p0_4, memory map ambaAPB
  PADDR=paddr, PWDATA=pwdata, PRDATA=prdata, PWRITE=pwrite, PSELx=psel, PENABLE=penable, PCLK=pclk, PRESETn=presetn
SlaveIntController: target spiritconsortium.org:busdef.leon2:IntProc:v1.0
  IRL=irl, IRQVEC=irqvec, INTack=intack
JTAG: target spiritconsortium.org:busdef.jtag:jtag:1.0
  TCK=tck, NTRST=ntrst, TMS=tms, TDI=tdi, TDO=tdo

## Ports
in rst_an
in clk
in clkn
in pclk
in presetn
in psel
in penable
in paddr[11:0]
in pwrite
in pwdata[31:0]
out prdata[31:0]
in hclk
in hresetn
in hgrant
in hready
in hresp[1:0]
in hrdata[31:0]
out hbusreq
out htrans[1:0]
out haddr[31:0]
out hwrite
out hsize[2:0]
out hburst[2:0]
out hprot[3:0]
out hwdata[31:0]
in irl[3:0]
out intack
out irqvec[3:0]
in tck
in ntrst
in tms
in tdi
out tdo
out SimDone

## Address spaces and blocks
main: range 4 * (2 ** 30), width 32
ambaAPB.registers: base , range 4, width 32, register
ambaAPB.lowest1k: base , range 1020, width 32, memory
ambaAPB.midlow1k: base , range 1 * (2 ** 10), width 32, memory
ambaAPB.midhigh1k: base , range 1 * (2 ** 10), width 32, memory
ambaAPB.highest1kx7_0: base , range 1 * (2 ** 10), width 8, memory
ambaAPB.highest1kx15_8: base , range 1 * (2 ** 10), width 8, memory
ambaAPB.highest1kx23_16: base , range 1 * (2 ** 10), width 8, memory
ambaAPB.highest1kx31_24: base , range 1 * (2 ** 10), width 8, memory

## Registers
Registers are 32-bit, read-only, no defined reset value unless marked. A register's access mark holds for its fields unless they carry their own. Offsets are from the block's base; lines under a group give offsets from that group; [hi:lo] are bit positions; {n}, {i} and the like mark numbered series; 'fields as' and 'values as' point back to an identical list; <NAME> marks a mode.

## ambaAPB.registers
Base 0x00000000
0x00 Failures
  [31:0] NumFailures — Number of failures from the AHB BFM

## Notices in the file
Copyright (c) 2006, 2008, 2009 The SPIRIT Consortium.
This work forms part of a deliverable of The SPIRIT Consortium.
Use of these materials are governed by the legal terms and conditions
outlined in the disclaimer available from www.spiritconsortium.org.
This source file is provided on an AS IS basis.  The SPIRIT
Consortium disclaims any warranty express or implied including
any warranty of merchantability and fitness for use for a
particular purpose.
The user of the source file shall indemnify and hold The SPIRIT
Consortium and its members harmless from any damages or liability.
